## conf/layer.conf
```bitbake
# We have a conf and classes directory, add to BBPATH
BBPATH .= ":${LAYERDIR}"

# We have recipes-* directories, add to BBFILES
BBFILES += "${LAYERDIR}/recipes-*/*/*.bb \
            ${LAYERDIR}/recipes-*/*/*.bbappend"

BBFILE_COLLECTIONS += "meta-mmts-rpi3"
BBFILE_PATTERN_meta-mmts-rpi3 = "^${LAYERDIR}/"
BBFILE_PRIORITY_meta-mmts-rpi3 = "6"

LAYERDEPENDS_meta-mmts-rpi3 = "core"
LAYERSERIES_COMPAT_meta-mmts-rpi3 = "dunfell"
MACHINE ?= "raspberrypi3"
IMAGE_FSTYPES = "tar.xz ext3 rpi-sdimg"
```
